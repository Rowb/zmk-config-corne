## config/west.yml
```yaml
manifest:
  remotes:
    - name: darknao
      url-base: https://github.com/darknao
  projects:
    - name: zmk
      remote: darknao
      revision: darknao/rgb-dts
      path: zmk
      import: app/west.yml
  self:
    path: config
```
